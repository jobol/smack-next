## security/Kconfig
```kconfig
#
# Security configuration
#

menu "Security options"

source security/keys/Kconfig

config SECURITY_DMESG_RESTRICT
	bool "Restrict unprivileged access to the kernel syslog"
	default n
	help
	  This enforces restrictions on unprivileged users reading the kernel
	  syslog via dmesg(8).

	  If this option is not selected, no restrictions will be enforced
	  unless the dmesg_restrict sysctl is explicitly set to (1).

	  If you are unsure how to answer this question, answer N.

config SECURITY
	bool "Enable different security models"
	depends on SYSFS
	depends on MULTIUSER
	help
	  This allows you to choose different security modules to be
	  configured into your kernel.

	  If this option is not selected, the default Linux security
	  model will be used.

	  If you are unsure how to answer this question, answer N.

config SECURITY_STACKING
	bool "Security module stacking"
	depends on SECURITY
	help
	  Allows multiple major security modules to be stacked.
	  Modules are invoked in the order registered with a
	  "bail on fail" policy, in which the infrastructure
	  will stop processing once a denial is detected. Not
	  all modules can be stacked. SELinux and Smack are
	  known to be incompatible. User space components may
	  have trouble identifying the security module providing
	  data in some cases.

	  If you select this option you will have to select which
	  of the stackable modules you wish to be active. The
	  "Default security module" will be ignored. The boot line
	  "security=" option can be used to specify that one of
	  the modules identifed for stacking should be used instead
	  of the entire stack.

	  If you are unsure how to answer this question, answer N.

config SECURITY_LSM_DEBUG
	bool "Enable debugging of the LSM infrastructure"
	depends on SECURITY
	help
	  This allows you to choose debug messages related to
	  security modules configured into your kernel.

	  If you are unsure how to answer this question, answer N.

config SECURITYFS
	bool "Enable the securityfs filesystem"
	help
	  This will build the securityfs filesystem.  It is currently used by
	  the TPM bios character driver and IMA, an integrity provider.  It is
	  not used by SELinux or SMACK.

	  If you are unsure how to answer this question, answer N.

config SECURITY_NETWORK
	bool "Socket and Networking Security Hooks"
	depends on SECURITY
	help
	  This enables the socket and networking security hooks.
	  If enabled, a security module can use these hooks to
	  implement socket and networking access controls.
	  If you are unsure how to answer this question, answer N.

config SECURITY_NETWORK_XFRM
	bool "XFRM (IPSec) Networking Security Hooks"
	depends on XFRM && SECURITY_NETWORK
	help
	  This enables the XFRM (IPSec) networking security hooks.
	  If enabled, a security module can use these hooks to
	  implement per-packet access controls based on labels
	  derived from IPSec policy.  Non-IPSec communications are
	  designated as unlabelled, and only sockets authorized
	  to communicate unlabelled data can send without using
	  IPSec.
	  If you are unsure how to answer this question, answer N.

config SECURITY_PATH
	bool "Security hooks for pathname based access control"
	depends on SECURITY
	help
	  This enables the security hooks for pathname based access control.
	  If enabled, a security module can use these hooks to
	  implement pathname based access controls.
	  If you are unsure how to answer this question, answer N.

config INTEL_TXT
	bool "Enable Intel(R) Trusted Execution Technology (Intel(R) TXT)"
	depends on HAVE_INTEL_TXT
	help
	  This option enables support for booting the kernel with the
	  Trusted Boot (tboot) module. This will utilize
	  Intel(R) Trusted Execution Technology to perform a measured launch
	  of the kernel. If the system does not support Intel(R) TXT, this
	  will have no effect.

	  Intel TXT will provide higher assurance of system configuration and
	  initial state as well as data reset protection.  This is used to
	  create a robust initial kernel measurement and verification, which
	  helps to ensure that kernel security mechanisms are functioning
	  correctly. This level of protection requires a root of trust outside
	  of the kernel itself.

	  Intel TXT also helps solve real end user concerns about having
	  confidence that their hardware is running the VMM or kernel that
	  it was configured with, especially since they may be responsible for
	  providing such assurances to VMs and services running on it.

	  See <http://www.intel.com/technology/security/> for more information
	  about Intel(R) TXT.
	  See <http://tboot.sourceforge.net> for more information about tboot.
	  See Documentation/intel_txt.txt for a description of how to enable
	  Intel TXT support in a kernel boot.

	  If you are unsure as to whether this is required, answer N.

config LSM_MMAP_MIN_ADDR
	int "Low address space for LSM to protect from user allocation"
	depends on SECURITY && SECURITY_SELINUX
	default 32768 if ARM || (ARM64 && COMPAT)
	default 65536
	help
	  This is the portion of low virtual memory which should be protected
	  from userspace allocation.  Keeping a user from writing to low pages
	  can help reduce the impact of kernel NULL pointer bugs.

	  For most ia64, ppc64 and x86 users with lots of address space
	  a value of 65536 is reasonable and should cause no problems.
	  On arm and other archs it should not be higher than 32768.
	  Programs which use vm86 functionality or have some need to map
	  this low address space will need the permission specific to the
	  systems running LSM.

source security/selinux/Kconfig
source security/smack/Kconfig
source security/tomoyo/Kconfig
source security/apparmor/Kconfig
source security/loadpin/Kconfig
source security/yama/Kconfig

source security/integrity/Kconfig

menu "Security Module Selection"
	visible if !SECURITY_STACKING

choice
	prompt "Default security module"
	default DEFAULT_SECURITY_SELINUX if SECURITY_SELINUX
	default DEFAULT_SECURITY_SMACK if SECURITY_SMACK
	default DEFAULT_SECURITY_TOMOYO if SECURITY_TOMOYO
	default DEFAULT_SECURITY_APPARMOR if SECURITY_APPARMOR
	default DEFAULT_SECURITY_DAC

	help
	  Select the security module that will be used by default if the
	  kernel parameter security= is not specified.

	config DEFAULT_SECURITY_SELINUX
		bool "SELinux" if SECURITY_SELINUX=y

	config DEFAULT_SECURITY_SMACK
		bool "Simplified Mandatory Access Control" if SECURITY_SMACK=y

	config DEFAULT_SECURITY_TOMOYO
		bool "TOMOYO" if SECURITY_TOMOYO=y

	config DEFAULT_SECURITY_APPARMOR
		bool "AppArmor" if SECURITY_APPARMOR=y

	config DEFAULT_SECURITY_DAC
		bool "Unix Discretionary Access Controls"

endchoice

config DEFAULT_SECURITY
	string
	default "selinux" if DEFAULT_SECURITY_SELINUX
	default "smack" if DEFAULT_SECURITY_SMACK
	default "tomoyo" if DEFAULT_SECURITY_TOMOYO
	default "apparmor" if DEFAULT_SECURITY_APPARMOR
	default "" if DEFAULT_SECURITY_DAC

endmenu

menu "Security Module Stack"
	visible if SECURITY_STACKING

choice
	prompt "Stacked 'extreme' security module"
	default SECURITY_SELINUX_STACKED if SECURITY_SELINUX
	default SECURITY_SMACK_STACKED if SECURITY_SMACK

	help
	  Enable an extreme security module. These modules cannot
	  be used at the same time.

	config SECURITY_SELINUX_STACKED
		bool "SELinux" if SECURITY_SELINUX=y
	help
	  Add the SELinux security module to the stack. At this
	  time the Smack security module is incompatible with this
	  module.
	  Please be sure your user space code is accomodating of
	  this security module.

	config SECURITY_SMACK_STACKED
		bool "Simplified Mandatory Access Control" if SECURITY_SMACK=y
	help
	  Add the Smack security module to the stack. At this
	  time the SELinux security module is incompatible with this
	  module.
	  Please be sure your user space code is accomodating of
	  this security module.

	config SECURITY_NOTHING_STACKED
		bool "Use no 'extreme' security module"
	help
	  Add neither the SELinux security module nor the Smack security
	  module to the stack.
	  Please be sure your user space code does not require either of
	  these security modules.

endchoice

config SECURITY_TOMOYO_STACKED
	bool "TOMOYO support is enabled by default"
	depends on SECURITY_TOMOYO && SECURITY_STACKING
	default n
	help
	  This option instructs the system to use the TOMOYO checks.
	  If not selected the module will not be invoked.
	  Stacked security modules may interact in unexpected ways.
	  Please be sure your user space code is accomodating of
	  multiple security modules.

	  If you are unsure how to answer this question, answer N.

config SECURITY_APPARMOR_STACKED
	bool "AppArmor support is enabled by default"
	depends on SECURITY_APPARMOR && SECURITY_STACKING
	default n
	help
	  This option instructs the system to use the AppArmor checks.
	  If not selected the module will not be invoked.
	  Stacked security modules may interact in unexpected ways.
	  Please be sure your user space code is accomodating of
	  multiple security modules.

	  If you are unsure how to answer this question, answer N.

endmenu

endmenu
```
